## components/hypervisor/Kconfig
```kconfig
menu "Hypervisor"

config RT_HYPERVISOR
    bool "Hypervisor: using rt-thread as hypervisor"
    default n
    help
        Type-2 Hypervisor.

if RT_HYPERVISOR
    config RT_USING_NVHE
        bool "RT_USING_NVHE: Using nVHE to implement Hypervisor. If choose n then using VHE."
        default y
        help
            Type-2 Hypervisor.

    config ARM64_ERRATUM_1530923
        bool "Cortex-A55: Speculative AT instruction using out-of-context translation regime could cause subsequent request to generate an incorrect translation"
        default n
        select ARM64_WORKAROUND_SPECULATIVE_AT
        help
            This option adds a workaround for ARM Cortex-A55 erratum 1530923.

            Affected Cortex-A55 cores (r0p0, r0p1, r1p0, r2p0) could end-up with
            corrupted TLBs by speculating an AT instruction during a guest
            context switch.

            If unsure, say Y.
    
    config MAX_VM_NUM
        int "MAX_VM_NUM: Maximum number of virtual machines running simultaneously."
        default 64
        help
            If this number greater than default value, than using 16-bits VMID.

    config MAX_OS_TYPE
        int "MAX_OS_TYPE: Maximum number of OS type supporting simultaneously."
        default 3
        help
            Additional OS information required.
endif

endmenu
```
